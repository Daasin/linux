## Documentation/devicetree/bindings/arm/apple/apple,pmgr.yaml
```yaml
# SPDX-License-Identifier: (GPL-2.0-only OR BSD-2-Clause)
%YAML 1.2
---
$id: http://devicetree.org/schemas/arm/apple/apple,pmgr.yaml#
$schema: http://devicetree.org/meta-schemas/core.yaml#

title: Apple SoC Power Manager (PMGR)

maintainers:
  - Hector Martin <marcan@marcan.st>

description: |
  Apple SoCs include a PMGR block responsible for power management,
  which can control various clocks, resets, power states, and
  performance features. This node represents the PMGR as a syscon,
  with sub-nodes representing individual features.

select:
  properties:
    compatible:
      contains:
        enum:
          - apple,t8103-pmgr
          - apple,pmgr

  required:
    - compatible

properties:
  $nodename:
    pattern: "^power-management@[0-9a-f]+$"

  compatible:
    items:
      - enum:
          - apple,t8103-pmgr
      - const: apple,pmgr
      - const: syscon
      - const: simple-mfd

  reg:
    maxItems: 1

required:
  - compatible
  - reg

additionalProperties: true

examples:
  - |
    soc {
        #address-cells = <2>;
        #size-cells = <2>;

        power-management@23b700000 {
            compatible = "apple,t8103-pmgr", "apple,pmgr", "syscon", "simple-mfd";
            #address-cells = <1>;
            #size-cells = <0>;
            reg = <0x2 0x3b700000 0x0 0x14000>;
        };
    };
```

## Documentation/devicetree/bindings/power/apple,pmgr-pwrstate.yaml
```yaml
# SPDX-License-Identifier: (GPL-2.0-only OR BSD-2-Clause)
%YAML 1.2
---
$id: http://devicetree.org/schemas/power/apple,pmgr-pwrstate.yaml#
$schema: http://devicetree.org/meta-schemas/core.yaml#

title: Apple SoC PMGR Power States

maintainers:
  - Hector Martin <marcan@marcan.st>

allOf:
  - $ref: "power-domain.yaml#"

description: |
  Apple SoCs include a PMGR block responsible for power management,
  which can control various clocks, resets, power states, and
  performance features. This binding describes the device power
  state registers, which control power states and resets.

  Each instance of a power controller within the PMGR syscon node
  represents a generic power domain provider, as documented in
  Documentation/devicetree/bindings/power/power-domain.yaml.
  The provider controls a single SoC block. The power hierarchy is
  represented via power-domains relationships between these nodes.
  
  See Documentation/devicetree/bindings/arm/apple/apple,pmgr.yaml
  for the top-level PMGR node documentation.

  IP cores belonging to a power domain should contain a
  "power-domains" property that is a phandle for the
  power domain node representing the domain.

properties:
  $nodename:
    pattern: "^power-controller@[0-9a-f]+$"

  compatible:
    items:
      - enum:
          - apple,t8103-pmgr-pwrstate
      - const: apple,pmgr-pwrstate

  reg:
    maxItems: 1

  "#power-domain-cells":
    const: 0

  "#reset-cells":
    const: 0

  power-domains:
    description:
      Reference to parent power domains. A domain may have multiple parents,
      and all will be powered up when it is powered.

  apple,domain-name:
    description: |
      Specifies the name of the SoC device being controlled. This is used to
      name the power/reset domains.
    $ref: /schemas/types.yaml#/definitions/string

  apple,always-on:
    description: |
      Forces this power domain to always be powered up.
    type: boolean

required:
  - compatible
  - reg
  - "#power-domain-cells"
  - "#reset-cells"
  - "apple,domain-name"

additionalProperties: false

examples:
  - |
    soc {
        #address-cells = <2>;
        #size-cells = <2>;

        power-management@23b700000 {
            compatible = "apple,t8103-pmgr", "apple,pmgr", "syscon", "simple-mfd";
            #address-cells = <1>;
            #size-cells = <0>;
            reg = <0x2 0x3b700000 0x0 0x14000>;

            ps_sio: power-controller@1c0 {
                compatible = "apple,t8103-pmgr-pwrstate", "apple,pmgr-pwrstate";
                reg = <0x1c0>;
                #power-domain-cells = <0>;
                #reset-cells = <0>;
                apple,domain-name = "sio";
                apple,always-on;
            };

            ps_uart_p: power-controller@220 {
                compatible = "apple,t8103-pmgr-pwrstate", "apple,pmgr-pwrstate";
                reg = <0x220>;
                #power-domain-cells = <0>;
                #reset-cells = <0>;
                apple,domain-name = "uart_p";
                power-domains = <&ps_sio>;
            };

            ps_uart0: power-controller@270 {
                compatible = "apple,t8103-pmgr-pwrstate", "apple,pmgr-pwrstate";
                reg = <0x270>;
                #power-domain-cells = <0>;
                #reset-cells = <0>;
                apple,domain-name = "uart0";
                power-domains = <&ps_uart_p>;
            };
          
        };
    };
```
